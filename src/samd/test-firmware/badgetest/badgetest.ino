#include "hw.h"
#include <Wire.h>
#include <Tone.h>

unsigned char pic1[]=
{/*--  12864LOGO.bmp  --*/
/*--  128x64  --*/
0xFF,0x01,0x01,0x01,0x01,0x01,0x01,0x01,0x01,0x01,0x01,0x01,0x01,0x01,0x01,0x01,
0x01,0x01,0x01,0x01,0x01,0x81,0xC1,0xF1,0xF9,0xFD,0xF1,0x01,0x81,0xC1,0x81,0x81,
0x81,0x81,0x01,0x01,0x01,0x01,0x01,0x01,0x01,0x01,0x01,0x01,0x01,0x01,0x01,0x01,
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0x80,0x80,0x80,0x80,0x80,0x80,0x80,0x80,0x80,0x80,0x80,0x80,0x80,0x80,0x80,0xFF,

};


#define NVM_MEMORY ((volatile uint16_t *)0x000000)
#define APP_START 0x400


static inline bool nvmReady(void) {
        return NVMCTRL->INTFLAG.reg & NVMCTRL_INTFLAG_READY;
}

__attribute__ ((long_call, section (".ramfunc")))
static void selfdestruct() {
    __disable_irq();
    while (!nvmReady())
        ;
    NVMCTRL->STATUS.reg |= NVMCTRL_STATUS_MASK;
    NVMCTRL->ADDR.reg  = (uintptr_t)&NVM_MEMORY[APP_START / 4];
    NVMCTRL->CTRLA.reg = NVMCTRL_CTRLA_CMD_ER | NVMCTRL_CTRLA_CMDEX_KEY;
    while (!nvmReady())
        ;
    NVIC_SystemReset() ;
    while (true);
}

Touchcontrol *t;
LEDcontrol *l;

void setup() {
  // put your setup code here, to run once:
  pinMode(2,OUTPUT);
  pinMode(3,OUTPUT);
  pinMode(4,OUTPUT);
  pinMode(5,OUTPUT);
  pinMode(6,OUTPUT);
  pinMode(7,OUTPUT);
  pinMode(9,OUTPUT);
  pinMode(10,OUTPUT);
  pinMode(11,OUTPUT);
  pinMode(12,OUTPUT);
  pinMode(16,OUTPUT);
  pinMode(20,OUTPUT);
  digitalWrite(20,LOW);
  digitalWrite(11,LOW); //bl mode
  digitalWrite(12,LOW); //hold esp32 in reset
  //Serial1.begin(115200);
  //Serial.begin(115200);
  digitalWrite(10,0);
  digitalWrite(2,HIGH);
  digitalWrite(9,HIGH);
  digitalWrite(16,HIGH);
  Wire.setClock(1000000);
  Wire.begin();
  Wire.setClock(1000000);
  InitDisplay();
  Display_Picture(pic1);
  t=new Touchcontrol(300);
  l=new LEDcontrol(10);
  l->setled(0,255,255,255);
  l->setled(1,255,255,255);
  l->setled(2,255,255,255);
  l->setled(3,255,255,255);
  l->setled(4,255,255,255);
  l->setled(5,255,255,255);
  l->setbl(255);
  
  delay(5000);
  selfdestruct();
  
}


void Start(uint8_t addr){
  Wire.beginTransmission(addr);
}

void Stop(){
  Wire.endTransmission();
}

void SendByte(uint8_t val){
  Wire.write(val);
}

void Set_Page_Address(unsigned char add)
{  Start(0x38);
  SendByte(0xb0|add);
  Stop();
}



void Set_Column_Address(unsigned char add)
{ Start(0x38);
  SendByte((0x10|(add>>4)));
  SendByte((0x0f&add)|0X04);
  Stop();
}

void Display_Picture(unsigned char pic[])
{
    unsigned char i,j,num=0;
  
  for(i=0;i<8;i++)
  {
    Set_Page_Address(i);
    for(num=0;num<4;num++){
      Set_Column_Address(num*0x20);
      
    
    Start(0x39);
        for(j=0;j<0x20;j++)
    {
        SendByte(pic[i*0x80+num*0x20+j]);
    }
    Stop();
    }
  }
}

void clearscreen(void){
    unsigned char i,j,num=0;
  
  for(i=0;i<8;i++)
  {
    Set_Page_Address(i);
    for(num=0;num<4;num++){
      Set_Column_Address(num*0x20);
      
    Start(0x39);
        for(j=0;j<0x20;j++)
    {
        SendByte(0);
    }
    Stop();
    }
  }
}

  


void InitDisplay(){
Start(0x38);
  
    SendByte(0x2f);        //Power_Control
    SendByte(0xA2);        // BIAS Setting   A2(1/9);A3(1/7)
    SendByte(0xA1);        // Set SEG Direction
    SendByte(0xC8);        // Set COM Direction
                          
    SendByte(0x24);        //Set VLCD Resistor Ratio    0-7
    SendByte(0x81);        // Set Electronic Volume
    SendByte(37);        // Contrast level  0~63
    SendByte(0x40);      //Initial_Dispay_Line
    SendByte(0xAF);        // Display ON

    Stop();

    Start(0x38); 
    SendByte(0xA7); //invert display
    Stop();


}


void loop() {
  
}


